## config/boards/shields/orthryn/Kconfig.defconfig
```kconfig
# Copyright (c) 2020 The ZMK Contributors
# SPDX-License-Identifier: MIT

if SHIELD_ORTHRYN_LEFT

config ZMK_KEYBOARD_NAME
	default "Orthryn Left"

config ZMK_SPLIT_BLE_ROLE_CENTRAL
	default y

endif


if SHIELD_ORTHRYN_RIGHT

config ZMK_KEYBOARD_NAME
	default "Orthryn Right"

endif

if SHIELD_ORTHRYN_LEFT || SHIELD_ORTHRYN_RIGHT

config ZMK_SPLIT
	default y
 
endif
```

## config/boards/shields/orthryn/Kconfig.shield
```kconfig
# Copyright (c) 2020 The ZMK Contributors
# SPDX-License-Identifier: MIT

config SHIELD_ORTHRYN_LEFT
	def_bool $(shields_list_contains,orthryn_left)

config SHIELD_ORTHRYN_RIGHT
	def_bool $(shields_list_contains,orthryn_right)
```

## config/boards/shields/skeletyl/Kconfig.defconfig
```kconfig
# Copyright (c) 2020 The ZMK Contributors
# SPDX-License-Identifier: MIT

if SHIELD_SKELETYL_LEFT

config ZMK_KEYBOARD_NAME
	default "skeletyl left"

config ZMK_SPLIT_BLE_ROLE_CENTRAL
	default y

endif

if SHIELD_SKELETYL_RIGHT

config ZMK_KEYBOARD_NAME
	default "skeletyl right"

endif

if SHIELD_SKELETYL_LEFT || SHIELD_SKELETYL_RIGHT

config ZMK_SPLIT
	default y
	
endif
```

## config/boards/shields/xd75/Kconfig.defconfig
```kconfig
# Copyright (c) 2020 The ZMK Contributors
# SPDX-License-Identifier: MIT

if SHIELD_XD75

config ZMK_KEYBOARD_NAME
	default "xd75"

endif
```

## config/boards/shields/xd75/Kconfig.shield
```kconfig
# Copyright (c) 2020 The ZMK Contributors
# SPDX-License-Identifier: MIT

config SHIELD_XD75
	def_bool $(shields_list_contains,xd75)
```
